## boards/shields/kaldera-bt/Kconfig.defconfig
```kconfig
if SHIELD_KALDERA_RIGHT

config ZMK_KEYBOARD_NAME
	default "Kaldera"

config ZMK_SPLIT_BLE_ROLE_CENTRAL
	default y

endif

if SHIELD_KALDERA_LEFT || SHIELD_KALDERA_RIGHT

config ZMK_SPLIT
	default y
	
endif
```

## boards/shields/kaldera-bt/Kconfig.shield
```kconfig
config SHIELD_KALDERA_LEFT
	def_bool $(shields_list_contains,kaldera_left)

config SHIELD_KALDERA_RIGHT
	def_bool $(shields_list_contains,kaldera_right)
```

## config/boards/shields/kaldera/Kconfig.defconfig
```kconfig
if SHIELD_KALDERA_LEFT

config ZMK_KEYBOARD_NAME
    default "Kaldera V2"

config ZMK_SPLIT_ROLE_CENTRAL
    default y

endif

if SHIELD_KALDERA_LEFT || SHIELD_KALDERA_RIGHT

config ZMK_SPLIT
    default y

endif
```

## config/boards/shields/kaldera/Kconfig.shield
```kconfig
# Copyright (c) 2020 The ZMK Contributors
# SPDX-License-Identifier: MIT

config SHIELD_KALDERA_LEFT
    def_bool $(shields_list_contains,kaldera_left)

config SHIELD_KALDERA_RIGHT
    def_bool $(shields_list_contains,kaldera_right)
```
