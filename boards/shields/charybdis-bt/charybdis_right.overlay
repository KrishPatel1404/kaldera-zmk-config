#include "charybdis.dtsi"

// The matrix transform is 6 columns over because the left half is 6 columns wide.
&default_transform {
	col-offset = <6>;
};

&kscan0 {
compatible = "zmk,kscan-gpio-matrix";

col-gpios
    = <&pro_micro 2 GPIO_ACTIVE_HIGH>
    , <&pro_micro 7 GPIO_ACTIVE_HIGH>
    , <&pro_micro 6 GPIO_ACTIVE_HIGH>
    , <&pro_micro 5 GPIO_ACTIVE_HIGH>
    , <&pro_micro 4 GPIO_ACTIVE_HIGH>
    , <&pro_micro 3 GPIO_ACTIVE_HIGH>
    ;
};